## configs/microclient_jr_defconfig
```kconfig
BR2_x86_i486=y
BR2_LUAROCKS_MIRROR="http://luarocks.org/repositories/rocks"
BR2_CPAN_MIRROR="http://search.cpan.org/CPAN"
BR2_KERNEL_HEADERS_3_14=y
BR2_TOOLCHAIN_BUILDROOT_LARGEFILE=y
BR2_TOOLCHAIN_BUILDROOT_INET_IPV6=y
BR2_TOOLCHAIN_BUILDROOT_INET_RPC=y
BR2_TOOLCHAIN_BUILDROOT_LOCALE=y
BR2_TOOLCHAIN_BUILDROOT_USE_SSP=y
BR2_BINUTILS_VERSION_2_24=y
BR2_TOOLCHAIN_BUILDROOT_CXX=y
BR2_PACKAGE_HOST_GDB=y
BR2_GDB_VERSION_7_8=y
BR2_TARGET_OPTIMIZATION="-pipe -mtune=i486"
BR2_TARGET_GENERIC_HOSTNAME="sis550_bb"
BR2_TARGET_GENERIC_ISSUE="Welcome to Buildroot BB"
BR2_ROOTFS_DEVICE_CREATION_DYNAMIC_MDEV=y
BR2_TARGET_GENERIC_GETTY_PORT="tty0"
# BR2_TARGET_GENERIC_REMOUNT_ROOTFS_RW is not set
BR2_LINUX_KERNEL=y
BR2_LINUX_KERNEL_CUSTOM_VERSION=y
BR2_LINUX_KERNEL_CUSTOM_VERSION_VALUE="3.14.24"
BR2_LINUX_KERNEL_USE_CUSTOM_CONFIG=y
BR2_LINUX_KERNEL_CUSTOM_CONFIG_FILE="board/norhtec/microclient-jr/linux-3.14.5.config"
BR2_PACKAGE_BUSYBOX_SHOW_OTHERS=y
BR2_PACKAGE_ALSA_UTILS=y
BR2_PACKAGE_ALSA_UTILS_ALSACONF=y
BR2_PACKAGE_ALSA_UTILS_APLAY=y
BR2_PACKAGE_ALSA_UTILS_SPEAKER_TEST=y
BR2_PACKAGE_FAAD2=y
BR2_PACKAGE_MPG123=y
BR2_PACKAGE_MPLAYER=y
BR2_PACKAGE_FLEX=y
BR2_PACKAGE_TREE=y
BR2_PACKAGE_E2TOOLS=y
BR2_PACKAGE_MINICOM=y
BR2_PACKAGE_PICOCOM=y
BR2_PACKAGE_LIBAO=y
BR2_PACKAGE_LIBID3TAG=y
BR2_PACKAGE_LIBMAD=y
BR2_PACKAGE_LIBSAMPLERATE=y
BR2_PACKAGE_LIBSNDFILE=y
BR2_PACKAGE_LIBVORBIS=y
BR2_PACKAGE_SPEEX=y
BR2_PACKAGE_LIBUSB=y
BR2_PACKAGE_JSON_C=y
BR2_PACKAGE_LIBCURL=y
BR2_PACKAGE_LIBMNL=y
BR2_PACKAGE_LIBNL=y
BR2_PACKAGE_LIBPCAP=y
BR2_PACKAGE_LIBTORRENT=y
BR2_PACKAGE_WVSTREAMS=y
BR2_PACKAGE_ELFUTILS=y
BR2_PACKAGE_LIBGLIB2=y
BR2_PACKAGE_DROPBEAR=y
BR2_PACKAGE_GESFTPSERVER=y
BR2_PACKAGE_TFTPD=y
BR2_PACKAGE_THTTPD=y
BR2_PACKAGE_VSFTPD=y
BR2_PACKAGE_FILE=y
BR2_PACKAGE_SCREEN=y
BR2_PACKAGE_CPULOAD=y
BR2_PACKAGE_HTOP=y
BR2_TARGET_ROOTFS_CPIO=y
BR2_TARGET_ROOTFS_CPIO_GZIP=y
BR2_TARGET_ROOTFS_EXT2=y
BR2_TARGET_ROOTFS_EXT2_2r1=y
BR2_TARGET_ROOTFS_SQUASHFS=y
BR2_TARGET_ROOTFS_TAR_GZIP=y
BR2_TARGET_SYSLINUX=y
BR2_TARGET_SYSLINUX_MBR=y
BR2_PACKAGE_HOST_SQUASHFS=y
```
